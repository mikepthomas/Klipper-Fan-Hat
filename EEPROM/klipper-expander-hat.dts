/dts-v1/;
/plugin/;

/ {
    compatible = "brcm,bcm2835";

    // Enable the i2c1 interface and set full speed baudrate
    fragment@0 {
        target = <&i2c1>;
        __overlay__ {
            status = "okay";
            clock-frequency = <400000>;
        };
    };
    // Enable the spi0 interface
    fragment@1 {
        target = <&spi0>;
        __overlay__ {
            status = "okay";
        };
    };
};
